## PACKAGES/ledrgbmatrix/Config.in
```kconfig
config BR2_PACKAGE_LEDRGBMATRIX
     bool "ledrgbmatrix"
     help 
       This file declare the LEDRGBMATRIX to buildroot.
       If any problems please contact : rom.laplace@gmail.com
```
